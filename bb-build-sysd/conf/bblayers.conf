## bb-build-sysd/conf/bblayers.conf
```bitbake
# POKY_BBLAYERS_CONF_VERSION is increased each time build/conf/bblayers.conf
# changes incompatibly
POKY_BBLAYERS_CONF_VERSION = "2"

BBPATH = "${TOPDIR}"
BBFILES ?= ""

BBLAYERS ?= " \
  $REPO_DIR/poky/meta \
  $REPO_DIR/poky/meta-poky \
  $REPO_DIR/poky/meta-yocto-bsp \
  $REPO_DIR/meta-ti/meta-beagle \
  $REPO_DIR/meta-ti/meta-ti-bsp \
  $REPO_DIR/meta-ti/meta-ti-extras \
  $REPO_DIR/meta-arm/meta-arm \
  $REPO_DIR/meta-arm/meta-arm-bsp \
  $REPO_DIR/meta-arm/meta-arm-toolchain \
  $REPO_DIR/meta-openembedded/meta-networking \
  $REPO_DIR/meta-virtualization \
  $REPO_DIR/meta-openembedded/meta-python \
  $REPO_DIR/meta-openembedded/meta-filesystems \
  $REPO_DIR/meta-openembedded/meta-oe \
  $REPO_DIR/meta-sw \
  $REPO_DIR/meta-custom \
  "
```

## bb-build-sysv/conf/bblayers.conf
```bitbake
# POKY_BBLAYERS_CONF_VERSION is increased each time build/conf/bblayers.conf
# changes incompatibly
POKY_BBLAYERS_CONF_VERSION = "2"

BBPATH = "${TOPDIR}"
BBFILES ?= ""

BBLAYERS ?= " \
  $REPO_DIR/poky/meta \
  $REPO_DIR/poky/meta-poky \
  $REPO_DIR/poky/meta-yocto-bsp \
  $REPO_DIR/meta-ti/meta-beagle \
  $REPO_DIR/meta-ti/meta-ti-bsp \
  $REPO_DIR/meta-ti/meta-ti-extras \
  $REPO_DIR/meta-arm/meta-arm \
  $REPO_DIR/meta-arm/meta-arm-bsp \
  $REPO_DIR/meta-arm/meta-arm-toolchain \
  $REPO_DIR/meta-virtualization \
  $REPO_DIR/meta-openembedded/meta-oe \
  $REPO_DIR/meta-openembedded/meta-networking \
  $REPO_DIR/meta-openembedded/meta-python \
  $REPO_DIR/meta-openembedded/meta-filesystems \
  $REPO_DIR/meta-openembedded/meta-multimedia \
  $REPO_DIR/meta-openembedded/meta-perl \
  $REPO_DIR/meta-openembedded/meta-gnome \
  $REPO_DIR/meta-openembedded/meta-xfce \
  $REPO_DIR/meta-openembedded/meta-webserver \
  $REPO_DIR/meta-openembedded/meta-initramfs \
  $REPO_DIR/meta-sw \
  $REPO_DIR/meta-custom \
  $REPO_DIR/meta-qt5 \
  "
```

## bb-build/conf/bblayers.conf
```bitbake
# POKY_BBLAYERS_CONF_VERSION is increased each time build/conf/bblayers.conf
# changes incompatibly
POKY_BBLAYERS_CONF_VERSION = "2"

BBPATH = "${TOPDIR}"
BBFILES ?= ""

BBLAYERS ?= " \
  /home/ahmed/Documents/yocto_organized/layers/poky/meta \
  /home/ahmed/Documents/yocto_organized/layers/poky/meta-poky \
  /home/ahmed/Documents/yocto_organized/layers/poky/meta-yocto-bsp \
  /home/ahmed/Documents/yocto_organized/layers/meta-ti \
  /home/ahmed/Documents/yocto_organized/layers/meta-arm/meta-arm \
  /home/ahmed/Documents/yocto_organized/layers/meta-arm/meta-arm-autonomy \
  /home/ahmed/Documents/yocto_organized/layers/meta-arm/meta-arm-bsp \
  /home/ahmed/Documents/yocto_organized/layers/meta-arm/meta-arm-toolchain \
  /home/ahmed/Documents/yocto_organized/layers/meta-openembedded/meta-networking \
  /home/ahmed/Documents/yocto_organized/layers/meta-virtualization \
  /home/ahmed/Documents/yocto_organized/layers/meta-openembedded/meta-python \
  /home/ahmed/Documents/yocto_organized/layers/meta-openembedded/meta-filesystems \
  /home/ahmed/Documents/yocto_organized/layers/meta-openembedded/meta-oe \
"
```

## meta-custom/conf/layer.conf
```bitbake
# Append conf and classes directory to BBPATH
BBPATH .= ":${LAYERDIR}"

# add folder structure to recipes (.bb) to BBFILES variable
BBFILES += "${LAYERDIR}/recipes*/*/*.bb"
```

## meta-sw/conf/layer.conf
```bitbake
# We have a conf and classes directory, add to BBPATH
BBPATH .= ":${LAYERDIR}"

# We have recipes-* directories, add to BBFILES
BBFILES += "${LAYERDIR}/recipes-*/*/*.bb \
            ${LAYERDIR}/recipes-*/*/*.bbappend"

BBFILE_COLLECTIONS += "meta-sw"
BBFILE_PATTERN_meta-sw = "^${LAYERDIR}/"
BBFILE_PRIORITY_meta-sw = "6"

LAYERDEPENDS_meta-sw = "core"
LAYERSERIES_COMPAT_meta-sw = "dunfell"
```

## rpi-build-sysd/conf/bblayers.conf
```bitbake
# POKY_BBLAYERS_CONF_VERSION is increased each time build/conf/bblayers.conf
# changes incompatibly
POKY_BBLAYERS_CONF_VERSION = "2"

BBPATH = "${TOPDIR}"
BBFILES ?= ""

BBLAYERS ?= " \
  /opt/yocto/ycoto-excersise/poky/meta \
  /opt/yocto/ycoto-excersise/poky/meta-poky \
  /opt/yocto/ycoto-excersise/poky/meta-yocto-bsp \
  /opt/yocto/ycoto-excersise/meta-raspberrypi \
  /opt/yocto/ycoto-excersise/meta-sw \
  /opt/yocto/ycoto-excersise/meta-qt5 \
  /opt/yocto/ycoto-excersise/meta-openembedded/meta-oe \
  /opt/yocto/ycoto-excersise/meta-openembedded/meta-networking \
  /opt/yocto/ycoto-excersise/meta-openembedded/meta-python \
  /opt/yocto/ycoto-excersise/meta-openembedded/meta-filesystems \
  /opt/yocto/ycoto-excersise/meta-openembedded/meta-multimedia \
  /opt/yocto/ycoto-excersise/meta-openembedded/meta-perl \
  /opt/yocto/ycoto-excersise/meta-openembedded/meta-gnome \
  /opt/yocto/ycoto-excersise/meta-openembedded/meta-xfce \
  /opt/yocto/ycoto-excersise/meta-openembedded/meta-webserver \
  /opt/yocto/ycoto-excersise/meta-openembedded/meta-initramfs \
  "
```

## rpi-build-sysv/conf/bblayers.conf
```bitbake
# POKY_BBLAYERS_CONF_VERSION is increased each time build/conf/bblayers.conf
# changes incompatibly
POKY_BBLAYERS_CONF_VERSION = "2"

BBPATH = "${TOPDIR}"
BBFILES ?= ""

BBLAYERS ?= " \
  /opt/yocto/ycoto-excersise/poky/meta \
  /opt/yocto/ycoto-excersise/poky/meta-poky \
  /opt/yocto/ycoto-excersise/poky/meta-yocto-bsp \
  /opt/yocto/ycoto-excersise/meta-raspberrypi \
  /opt/yocto/ycoto-excersise/meta-sw \
  "
```

## rpi-build/conf/bblayers.conf
```bitbake
# POKY_BBLAYERS_CONF_VERSION is increased each time build/conf/bblayers.conf
# changes incompatibly
POKY_BBLAYERS_CONF_VERSION = "2"

BBPATH = "${TOPDIR}"
BBFILES ?= ""

BBLAYERS ?= " \
  $REPO_DIR/layers/poky/meta \
  $REPO_DIR/layers/poky/meta-poky \
  $REPO_DIR/layers/poky/meta-yocto-bsp \
  $REPO_DIR/layers/meta-raspberrypi \
  $REPO_DIR/layers/meta-sw \
  "
```
